## boards/shields/bleuet/Kconfig.defconfig
```kconfig
# Copyright (c) 2024 Dallas Johnson
# SPDX-License-Identifier: MIT

if SHIELD_BLEUET_LEFT

config ZMK_KEYBOARD_NAME
    default "Bleuet"

config ZMK_SPLIT_ROLE_CENTRAL
    default y

endif

if SHIELD_BLEUET_LEFT || SHIELD_BLEUET_RIGHT

config ZMK_SPLIT
    default y

endif
```

## boards/shields/bleuet/Kconfig.shield
```kconfig
# Copyright (c) 2024 Dallas Johnson
# SPDX-License-Identifier: MIT

config SHIELD_BLEUET_LEFT
    def_bool $(shields_list_contains,bleuet_left)

config SHIELD_BLEUET_RIGHT
    def_bool $(shields_list_contains,bleuet_right)
```

## boards/shields/unigo66/Kconfig.defconfig
```kconfig
# Copyright (c) 2024 Dallas Johnson
# SPDX-License-Identifier: MIT

if SHIELD_UNIGO66

config ZMK_KEYBOARD_NAME
    default "Unigo66"

endif
```

## boards/shields/unigo66/Kconfig.shield
```kconfig
# Copyright (c) 2024 Dallas Johnson
# SPDX-License-Identifier: MIT

config SHIELD_UNIGO66
    def_bool $(shields_list_contains,unigo66)
```

## config/west.yml
```yaml
manifest:
  remotes:
    - name: Dallas-J
      url-base: https://github.com/Dallas-J
    # Additional modules containing boards/shields/custom code can be listed here as well
    # See https://docs.zephyrproject.org/3.2.0/develop/west/manifest.html#projects
  projects:
    - name: zmk
      remote: Dallas-J
      revision: main
      import: app/west.yml
  self:
    path: config
```
